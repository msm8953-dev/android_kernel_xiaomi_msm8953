## drivers/input/touchscreen/Kconfig
```kconfig
#
# Touchscreen Input device configuration
#

if MACH_XIAOMI_MSM8953

source "drivers/input/touchscreen/xiaomi/mido/Kconfig"

source "drivers/input/touchscreen/xiaomi/ysl/Kconfig"

endif
```
